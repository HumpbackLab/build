## boards/cv181x/sg2002_tidesense_arm64_sd/sg2002_tidesense_arm64_sd_defconfig
```kconfig
CONFIG_CHIP_sg2002=y
CONFIG_BOARD_tidesense_arm64_sd=y
CONFIG_SENSOR_OV_OV9281=y
CONFIG_DDR_CFG_ddr3_1866_x16=y
CONFIG_ARCH="arm64"
CONFIG_CC_OPTIMIZE_FOR_SIZE=y
CONFIG_CROSS_COMPILE_KERNEL="aarch64-linux-gnu-"
CONFIG_KERNEL_ENTRY_HACK=y
CONFIG_KERNEL_ENTRY_HACK_ADDR="0x80108000"
CONFIG_TOOLCHAIN_GLIBC_ARM64=y
CONFIG_FLASH_SIZE_SHRINK=y
CONFIG_BOOT_IMAGE_SINGLE_DTB=y
CONFIG_STORAGE_TYPE_sd=y
CONFIG_UBOOT_2021_10=y
CONFIG_KERNEL_SRC_5.10=y
CONFIG_KERNEL_SRC="linux_5.10"
CONFIG_KERNEL_LZMA=y
CONFIG_SKIP_RAMDISK=y
# CONFIG_ROOTFS_OVERLAYFS is not set
CONFIG_BUILDROOT_FS=n
CONFIG_TARGET_PACKAGE_DROPBEAR=y
CONFIG_TARGET_PACKAGE_RNDIS_SCRIPT=y
# CONFIG_TARGET_PACKAGE_MTD-UTILS is not set
# CONFIG_TARGET_PACKAGE_RSYSLOG is not set
# CONFIG_TARGET_PACKAGE_GATORD is not set
CONFIG_ENABLE_FREERTOS=y
CONFIG_ENABLE_RTOS_DUMP_PRINT=y
CONFIG_DUMP_PRINT_SZ_IDX=17
CONFIG_TARGET_PACKAGE_NTP=y
```
